
/* Задаем бибилиотеки. Они доступны бесплатно на специальной платформе.*/

#include <Wire.h>
#include <Adafruit_MCP4725.h>
int freq = 0;
Adafruit_MCP4725 dac;

/* В представленное окно вставляем цифру при каком разрешении хотим получать картинку 12, 9 , 8, 7, 6, 5 */
#define DAC_RESOLUTION    (12)
          
  /* конвертируем нужны сигнал в битную систему, в зависимости от разрешения и вставляем набор цифр через ","  */
 
const PROGMEM uint16_t DACLookup_FullSine_12Bit[4096] =
{0, 0, 0, 0, 0, 0, 0, 0, 0, 0, 0, 0, 0,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 0, 0};
const PROGMEM uint16_t DACLookup_FullSine_6Bit[64] =
{
  2048, 2248, 2447, 2642, 2831, 3013, 3185, 3346,
  3495, 3630, 3750, 3853, 3939, 4007, 4056, 4085,
  4095, 4085, 4056, 4007, 3939, 3853, 3750, 3630,
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   600,  749,  910, 1082, 1264, 1453, 1648, 1847
};

const PROGMEM uint16_t DACLookup_FullSine_5Bit[32] =
{
  0, 0, 0, 0, 0, 0, 0, 0,
  50, 50, 50, 50, 50, 0, 0, 0,
  0, 0, 0,  0,  0,  0,  0,   0,
     0,   0,  0,  0,  0,  0, 0, 0
};

void setup(void) {
  Serial.begin(9600);
  
  
/* Далее запускаем основной блок программы для генерации сигнала */

  dac.begin(0x60);

  Serial.println("Signal generation");

}

void loop(void) {
    uint16_t i;
 freq = analogRead(A0)+1;   // Указываем подключение потенциометра для регилирования частоты
   int per = map(freq, 0, 670, 0, 270); // Конвертируем в радианы, чтобы видеть на какой угол мы поворачиваем потенциометр
  Serial.print("Analog Reading: ");   
Serial.print(freq);                   // Выводим на печать в последовательный порт необработанные("сырые") аналоговые значения
   Serial.print("  Angle of rotation: ");     
  Serial.print(per);                   // Выводим на печать в последовательный порт значения в процентах
 Serial.println("  радиан");                 // Выводим на печать в последовательный порт символ % и новой строки
       delay(5000);                              // Регулируем задержку сигнала

  
    /* Выбираем нужное значение в зависимости от выбранного разрешения */

    #if DAC_RESOLUTION == 5
      for (i = 0; i < 32; i++)
      {
        dac.setVoltage(pgm_read_word(&(DACLookup_FullSine_5Bit[i])), false);
        delayMicroseconds(freq);
      }
    #elif DAC_RESOLUTION == 6
      for (i = 0; i < 64; i++)
      {
        dac.setVoltage(pgm_read_word(&(DACLookup_FullSine_6Bit[i])), false);
        delayMicroseconds(freq);
      }
    #elif DAC_RESOLUTION == 7
      for (i = 0; i < 128; i++)
      {
        dac.setVoltage(pgm_read_word(&(DACLookup_FullSine_7Bit[i])), false);
        delayMicroseconds(freq);
      }
    #elif DAC_RESOLUTION == 9
      for (i = 0; i < 512; i++)
      {
        dac.setVoltage(pgm_read_word(&(DACLookup_FullSine_9Bit[i])), false);
      delayMicroseconds(freq);
      }
    #elif DAC_RESOLUTION == 12
      for (i = 0; i < 4096; i++)
      {
        dac.setVoltage(pgm_read_word(&(DACLookup_FullSine_12Bit[i])), false);
        delayMicroseconds(freq);
      }
    #else    // Use 8-bit data if nothing else is specified
      for (i = 0; i < 256; i++)
      {
        dac.setVoltage(pgm_read_word(&(DACLookup_FullSine_8Bit[i])), false);
        delayMicroseconds(freq);
      }

    #endif
}

